## boards/shields/TEST/Kconfig.defconfig
```kconfig
if SHIELD_TEST_LEFT

# Name must be less than 16 characters long!
config ZMK_KEYBOARD_NAME
    default "TESTKey"

config ZMK_SPLIT_ROLE_CENTRAL
    default y

endif

if SHIELD_TEST_LEFT || SHIELD_TEST_RIGHT

config ZMK_SPLIT
    default y
    CONFIG_ZMK_POINTING=y
    CONFIG_ZMK_POINTING_SMOOTH_SCROLLING=y

endif
```

## boards/shields/TEST/Kconfig.shield
```kconfig
# No whitespace after the comma or in your part name!
config SHIELD_TEST_LEFT
    def_bool $(shields_list_contains,TEST_left)

# No whitespace after the comma or in your part name!
config SHIELD_TEST_RIGHT
    def_bool $(shields_list_contains,TEST_right)
```
